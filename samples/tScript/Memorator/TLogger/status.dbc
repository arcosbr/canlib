VERSION "HIPBNYYYYYYYYYYYYYYYYYYYYYYYYYYYYYYYYYYYYY/4/%%%/4/'%**4YYY///"

NS_ :

BS_:

BU_:

BO_ 0 StatusMessage: 8 Vector__XXX
 SG_ Temperature : 0|8@1+ (1,0) [0|0] "" Vector__XXX
 SG_ Pressure : 8|8@1+ (1,0) [0|0] "" Vector__XXX
